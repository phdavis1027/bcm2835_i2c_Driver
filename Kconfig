## Kconfig
```kconfig
config BCM2835_I2C_DRIVER
	bool "Connect to BCM2835's on-chip 3 I2C-compliant Broadcom Serial Controllers"
	default n
	depends on GPIO
	help
		I2C driver for BCM2835 (SoC used in Pi 4 Model B)
```

## dts/bindings/broadcom,bcm2835.yaml
```yaml
description: "BSC Driver for BCM2835"
compatible: "broadcom,bcm2835"
include: [i2c-controller.yaml]
```

## dts/bindings/broadcom,bcm2835bsc.yaml
```yaml
description: "BSC Driver for BCM2835"
compatible: "broadcom,bcm2835bsc"
include: [i2c-controller.yaml]
```
